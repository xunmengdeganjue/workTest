## smartrouter/makefile_test/Config.in
```kconfig
# Copyright (C) 2006-2013 OpenWrt.org
#
# This is free software, licensed under the GNU General Public License v2.
# See /LICENSE for more information.
#

mainmenu "Learning OpenWRT Configuration"

config MODULES
        bool
        default y

config HAVE_DOT_CONFIG
        bool
        default y

source "target/Config.in"
#source "target/Config.in"
#source "target/Config.in"
source "config/Config.in"
```
